// Host unit test for the LMAF framing core (firmware_common/lma_attachment).
//
// The golden bytes are generated from the protobuf definitions
// (proto/lma_messages.proto -> proto/lma_messages_pb2.py), so this test pins
// the MCU encoder to the same wire format the server's generated stubs produce.
// Regenerate them with the snippet documented in proto/lma_messages.proto's
// LMAF section (see also tests/test_lma_attachment.py, which asserts the Python
// side against the same vectors).
#include <cstdio>
#include <string>
#include <vector>

#include "lma_attachment.h"

using namespace lma_attachment;

static int failures = 0;

static std::string to_hex(const std::string& b) {
    static const char* H = "0123456789abcdef";
    std::string s;
    for (unsigned char c : b) {
        s.push_back(H[c >> 4]);
        s.push_back(H[c & 0x0f]);
    }
    return s;
}

static void check(bool ok, const char* label) {
    if (ok) {
        std::printf("ok   %s\n", label);
    } else {
        std::printf("FAIL %s\n", label);
        failures++;
    }
}

static void check_eq(const std::string& actual, const std::string& expected, const char* label) {
    if (actual == expected) {
        std::printf("ok   %s\n", label);
        return;
    }
    std::printf("FAIL %s\n  actual  : %s\n  expected: %s\n", label,
                to_hex(actual).c_str(), to_hex(expected).c_str());
    failures++;
}

static void check_u32(uint32_t actual, uint32_t expected, const char* label) {
    if (actual == expected) {
        std::printf("ok   %s\n", label);
        return;
    }
    std::printf("FAIL %s (actual %u, expected %u)\n", label, (unsigned)actual, (unsigned)expected);
    failures++;
}

static std::string from_hex(const char* h) {
    auto nib = [](char c) -> int {
        if (c >= '0' && c <= '9') return c - '0';
        if (c >= 'a' && c <= 'f') return c - 'a' + 10;
        if (c >= 'A' && c <= 'F') return c - 'A' + 10;
        return 0;
    };
    std::string out;
    for (size_t i = 0; h[i] && h[i + 1]; i += 2) {
        out.push_back((char)((nib(h[i]) << 4) | nib(h[i + 1])));
    }
    return out;
}

// ── Golden vectors (protobuf-generated) ─────────────────────────────────────
static const char* G_ID_HEX        = "000102030405060708090a0b0c0d0e0f";
static const char* G_SHA256_HEX    = "a0a1a2a3a4a5a6a7a8a9aaabacadaeaf"
                                     "b0b1b2b3b4b5b6b7b8b9babbbcbdbebf";
static const uint32_t G_CRC_DATA3   = 1438416925u;
static const uint32_t G_CRC_DATA240 = 2785741670u;

static const char* G_MANIFEST =
    "0a10000102030405060708090a0b0c0d0e0f"
    "1220a0a1a2a3a4a5a6a7a8a9aaabacadaeafb0b1b2b3b4b5b6b7b8b9babbbcbdbebf"
    "180622126c6d616f3a63686172742d6c696e652d7631"
    "28f001300238fc026a10663566303539353233393236323733397080a6c1d59733";

static const char* G_CHUNK = "0a10000102030405060708090a0b0c0d0e0f10011a03010203251d80bc55";

static const char* G_ACK =
    "0a10000102030405060708090a0b0c0d0e0f10021801200120032a046c6f7373";

static const char* G_CAPS =
    "0801100110061a0b636f646563323a37303043"
    "1a126c6d616f3a63686172742d6c696e652d763120f001288080013008";

static Manifest golden_manifest() {
    Manifest m;
    m.id = from_hex(G_ID_HEX);
    m.payload_sha256 = from_hex(G_SHA256_HEX);
    m.kind = KIND_CHART;
    m.codec = "lmao:chart-line-v1";
    m.chunk_size = 240;
    m.chunk_count = 2;
    m.total_bytes = 380;
    m.node_id = "f5f0595239262739";
    m.created_ms = 1758700000000ULL;
    return m;
}

// Envelope wrapper = field tag (2 bytes for fields 40-50) + inner length
// (varint).  These prefixes come straight from the protobuf-generated bytes.
static std::string env_hex(const char* prefix, const char* inner) {
    return from_hex(prefix) + from_hex(inner);
}

static void test_encoder_golden() {
    const Manifest m = golden_manifest();

    check_eq(encode_manifest(m), from_hex(G_MANIFEST), "encode_manifest golden");
    check_eq(envelope_manifest(m), env_hex("c2026b", G_MANIFEST), "envelope_manifest golden");

    const std::string data3 = from_hex("010203");
    check_u32(crc32(data3.data(), data3.size()), G_CRC_DATA3, "crc32 of 010203");
    check_eq(encode_chunk(m.id, 1, data3, G_CRC_DATA3), from_hex(G_CHUNK), "encode_chunk golden");
    check_eq(envelope_chunk(m.id, 1, data3, G_CRC_DATA3), env_hex("ca021e", G_CHUNK),
             "envelope_chunk golden");

    const std::vector<uint32_t> missing = {1, 3};
    check_eq(encode_ack(m.id, ACK_NEED, 1, missing, "loss"), from_hex(G_ACK), "encode_ack golden");
    check_eq(envelope_ack(m.id, ACK_NEED, 1, missing, "loss"), env_hex("d20220", G_ACK),
             "envelope_ack golden");

    const std::vector<uint32_t> kinds = {KIND_VOICE, KIND_CHART};
    const std::vector<std::string> codecs = {"codec2:700C", "lmao:chart-line-v1"};
    check_eq(encode_capability(1, kinds, codecs, 240, 16384, 8), from_hex(G_CAPS),
             "encode_capability golden");
    check_eq(envelope_capability(1, kinds, codecs, 240, 16384, 8), env_hex("920330", G_CAPS),
             "envelope_capability golden");
}

// The whole point of the 240 B chunk: a chunk envelope must still fit one
// opportunistic LXMF packet.  The framing of a full-size chunk is pinned
// separately from the 3-byte vector above (2-byte length prefixes are the
// boundary case that a hand encoder gets wrong).
static void test_chunk_size_budget() {
    std::string data;
    for (int i = 0; i < 240; i++) data.push_back((char)(i % 256));
    check_u32(crc32(data.data(), data.size()), G_CRC_DATA240, "crc32 of 240-byte pattern");

    const std::string id = from_hex(G_ID_HEX);
    const std::string env = envelope_chunk(id, 0, data, G_CRC_DATA240);

    check_eq(env.substr(0, 4), from_hex("ca028a02"), "240B envelope prefix (field 41, len=266)");
    check_eq(env.substr(env.size() - 5), from_hex("25660b0ba6"), "240B envelope CRC field tail");
    check_eq(std::to_string(env.size()), std::to_string(270), "240B envelope size");
    check(env.size() <= MAX_ENVELOPE_BYTES, "240B envelope within opportunistic budget");
    check_u32(LO_OPP_CHUNK_SIZE, 240, "opportunistic chunk size constant");
}

static void test_decoder_golden() {
    Decoded d = decode_envelope(env_hex("c2026b", G_MANIFEST));
    check(d.payload == Payload::MANIFEST, "decode manifest: payload kind");
    check(d.manifest.id == from_hex(G_ID_HEX), "decode manifest: id");
    check(d.manifest.payload_sha256 == from_hex(G_SHA256_HEX), "decode manifest: sha256");
    check_u32(d.manifest.kind, KIND_CHART, "decode manifest: kind");
    check(d.manifest.codec == "lmao:chart-line-v1", "decode manifest: codec");
    check_u32(d.manifest.chunk_size, 240, "decode manifest: chunk_size");
    check_u32(d.manifest.chunk_count, 2, "decode manifest: chunk_count");
    check(d.manifest.total_bytes == 380, "decode manifest: total_bytes");
    check(d.manifest.node_id == "f5f0595239262739", "decode manifest: node_id");
    check(d.manifest.created_ms == 1758700000000ULL, "decode manifest: created_ms");

    d = decode_envelope(env_hex("ca021e", G_CHUNK));
    check(d.payload == Payload::CHUNK, "decode chunk: payload kind");
    check(d.chunk_id == from_hex(G_ID_HEX), "decode chunk: id");
    check_u32(d.chunk_index, 1, "decode chunk: index");
    check(d.chunk_data == from_hex("010203"), "decode chunk: data");
    check_u32(d.chunk_crc32, G_CRC_DATA3, "decode chunk: crc32");

    d = decode_envelope(env_hex("d20220", G_ACK));
    check(d.payload == Payload::ACK, "decode ack: payload kind");
    check_u32(d.ack_status, ACK_NEED, "decode ack: status");
    check_u32(d.ack_have, 1, "decode ack: have_count");
    check(d.ack_missing.size() == 2 && d.ack_missing[0] == 1 && d.ack_missing[1] == 3,
          "decode ack: missing list");
    check(d.ack_reason == "loss", "decode ack: reason");

    d = decode_envelope(env_hex("920330", G_CAPS));
    check(d.payload == Payload::CAPABILITY, "decode caps: payload kind");
    check_u32(d.caps_version, 1, "decode caps: lmaf_version");
    check(d.caps_kinds.size() == 2 && d.caps_kinds[0] == KIND_VOICE && d.caps_kinds[1] == KIND_CHART,
          "decode caps: kinds");
    check(d.caps_codecs.size() == 2 && d.caps_codecs[0] == "codec2:700C", "decode caps: codecs");
    check_u32(d.caps_max_chunk, 240, "decode caps: max_chunk_size");
    check(d.caps_max_bytes == 16384, "decode caps: max_attachment_bytes");
    check_u32(d.caps_rx_window, 8, "decode caps: rx_window");
}

static void test_decoder_tolerance() {
    // Unknown fields must be skipped (forward compatibility with a newer
    // sender, e.g. one that sets Manifest.meta): field 99 varint + field 16
    // length-delimited, both validly encoded.
    std::string env = env_hex("ca021e", G_CHUNK);
    env.push_back((char)0x98);   // varint tag: 0x98 0x06 -> field 99, wire type 0
    env.push_back((char)0x06);
    env.push_back((char)0x2a);
    env.push_back((char)0x82);   // varint tag: 0x82 0x01 -> field 16, wire type 2
    env.push_back((char)0x01);
    env.push_back((char)0x03);
    env.append("abc", 3);
    Decoded d = decode_envelope(env);
    check(d.payload == Payload::CHUNK, "unknown trailing fields: still CHUNK");
    check(d.chunk_data == from_hex("010203"), "unknown trailing fields: data intact");

    // A non-LMAF LMAOEnvelope (field 20 = text) reads as OTHER, not NONE.
    d = decode_envelope(from_hex("a20103") /* field 20, len 3 */ + std::string("\x08\x01\x0a"));
    check(d.payload == Payload::OTHER, "non-LMAF envelope classified as OTHER");

    // Garbage and truncation must never crash or report a payload.
    check(decode_envelope(std::string("\xff\xff\xff\xff\xff", 5)).payload == Payload::NONE,
          "garbage envelope: NONE");
    check(decode_envelope(from_hex("ca021e0a10")).payload == Payload::NONE,
          "truncated chunk envelope: NONE");
    check(decode_envelope(std::string()).payload == Payload::NONE, "empty envelope: NONE");
}

// ── Reassembler ─────────────────────────────────────────────────────────────

struct Harness {
    std::string               buffer;
    uint32_t                  chunk_size = 0;
    uint32_t                  writes     = 0;
    bool                      fail_next  = false;

    Reassembler::Sink sink() {
        return [this](uint32_t index, const char* data, size_t len) {
            if (fail_next) return false;
            const size_t off = (size_t)index * chunk_size;
            if (off + len > buffer.size()) return false;
            buffer.replace(off, len, data, len);
            writes++;
            return true;
        };
    }
};

static Manifest session_manifest(const std::string& payload, uint32_t chunk_size) {
    Manifest m;
    m.id = "0123456789abcdef";           // 16-byte session key in production
    m.payload_sha256 = "00";
    m.kind = KIND_CHART;
    m.codec = "lmao:chart-line-v1";
    m.chunk_size = chunk_size;
    m.total_bytes = payload.size();
    m.chunk_count = (uint32_t)((payload.size() + chunk_size - 1) / chunk_size);
    return m;
}

static void test_reassembler_out_of_order() {
    const std::string payload = "DATA 7b38fa21 30 60 3 21 22 23 3 40 41 42 3 10 11 12";
    Harness h;
    h.chunk_size = 16;
    h.buffer.assign(payload.size(), '\0');

    Reassembler r;
    const Manifest m = session_manifest(payload, 16);
    check(r.begin(m, h.sink()) == Reassembler::Outcome::ACCEPTED, "reasm: begin");
    check_u32(r.have_count(m.id), 0, "reasm: starts empty");
    check(r.missing(m.id).size() == m.chunk_count, "reasm: all missing at start");

    // Deliver in reverse order.
    for (int i = (int)m.chunk_count - 1; i >= 0; i--) {
        const size_t off = (size_t)i * 16;
        const std::string part = payload.substr(off, 16);
        const uint32_t crc = crc32(part.data(), part.size());
        const Reassembler::Outcome o = r.on_chunk(m.id, (uint32_t)i, part, crc);
        const bool last = (i == 0);
        check(o == (last ? Reassembler::Outcome::COMPLETE : Reassembler::Outcome::ACCEPTED),
              last ? "reasm: last chunk completes" : "reasm: chunk accepted");
    }
    check(h.buffer == payload, "reasm: payload byte-identical");
    check(r.complete(m.id), "reasm: complete()");
    check(r.missing(m.id).empty(), "reasm: nothing missing");

    // Duplicate and bad CRC are ignored, not double-counted.
    const std::string part0 = payload.substr(0, 16);
    check(r.on_chunk(m.id, 0, part0, crc32(part0.data(), part0.size())) ==
              Reassembler::Outcome::DUPLICATE, "reasm: duplicate ignored");
    check_u32(r.have_count(m.id), m.chunk_count, "reasm: duplicate does not double count");
    check(r.on_chunk(m.id, 1, payload.substr(16, 16), 0xdeadbeef) ==
              Reassembler::Outcome::BAD_CRC, "reasm: bad CRC rejected");
    check(r.missing(m.id).empty(), "reasm: rejected CRC stored nothing");
}

static void test_reassembler_rejections() {
    Reassembler r;
    Harness h;
    h.chunk_size = 16;
    h.buffer.assign(48, '\0');

    const std::string payload(44, 'x');
    Manifest m = session_manifest(payload, 16);
    check(r.begin(m, h.sink()) == Reassembler::Outcome::ACCEPTED, "reject: begin");

    check(r.on_chunk("ffffffffffffffff", 0, "x", 0) == Reassembler::Outcome::NO_SESSION,
          "reject: unknown session");
    check(r.on_chunk(m.id, m.chunk_count, "x", 0) == Reassembler::Outcome::BAD_INDEX,
          "reject: index out of range");
    check(r.on_chunk(m.id, 0, std::string(17, 'y'), 0) == Reassembler::Outcome::TOO_LARGE,
          "reject: chunk larger than chunk_size");
    check_u32(r.have_count(m.id), 0, "reject: nothing stored");

    // Sink failure must surface, and not mark the chunk as held.
    h.fail_next = true;
    check(r.on_chunk(m.id, 0, payload.substr(0, 16), 0) == Reassembler::Outcome::IO_ERROR,
          "reject: sink failure surfaces");
    h.fail_next = false;
    check(r.missing(m.id).size() == m.chunk_count, "reject: IO error stored nothing");

    // Inconsistent / over-limit manifests are refused outright.
    std::string err;
    Manifest bad = m;
    bad.chunk_count = 999;
    check(r.begin(bad, h.sink(), &err) == Reassembler::Outcome::BAD_MANIFEST,
          "reject: chunk_count/total mismatch");
    bad = m;
    bad.total_bytes = 1u << 20;
    bad.chunk_count = (uint32_t)((bad.total_bytes + 15) / 16);
    check(r.begin(bad, h.sink(), &err) == Reassembler::Outcome::BAD_MANIFEST,
          "reject: payload over max_total_bytes");
    bad = m;
    bad.chunk_size = 8192;
    bad.chunk_count = 1;
    check(r.begin(bad, h.sink(), &err) == Reassembler::Outcome::BAD_MANIFEST,
          "reject: chunk over max_chunk_size");
    bad = m;
    bad.chunk_count = 0;
    check(r.begin(bad, h.sink(), &err) == Reassembler::Outcome::BAD_MANIFEST,
          "reject: zero chunk_count");
}

static void test_reassembler_resume_and_ttl() {
    // A virtual clock so TTL is deterministic on the host.
    double clock = 1000.0;
    Limits limits;
    limits.ttl_seconds = 60.0;
    limits.max_sessions = 2;
    Reassembler r(limits, [&clock]() { return clock; });

    Harness h;
    h.chunk_size = 16;
    h.buffer.assign(44, '\0');

    const std::string payload(44, 'a');
    const Manifest m = session_manifest(payload, 16);
    check(r.begin(m, h.sink()) == Reassembler::Outcome::ACCEPTED, "resume: begin");
    check(r.on_chunk(m.id, 0, payload.substr(0, 16), 0) == Reassembler::Outcome::ACCEPTED,
          "resume: first chunk");

    // Identical manifest re-sent (the loss-recovery case): chunks survive.
    check(r.begin(m, h.sink()) == Reassembler::Outcome::ACCEPTED, "resume: identical manifest");
    check_u32(r.have_count(m.id), 1, "resume: held chunk survives re-manifest");
    check(r.missing(m.id).size() == 2, "resume: still needs the rest");

    // A manifest with a different shape restarts the session.
    Manifest other = m;
    other.total_bytes = 40;
    other.chunk_count = 3;
    check(r.begin(other, h.sink()) == Reassembler::Outcome::ACCEPTED, "resume: new shape accepted");
    check_u32(r.have_count(m.id), 0, "resume: new shape discards old chunks");

    // TTL expiry drops the partial session; a late chunk is then unsolicited.
    clock += limits.ttl_seconds + 1.0;
    r.expire();
    check_u32(r.session_count(), 0, "ttl: expired session dropped");
    check(r.on_chunk(m.id, 0, payload.substr(0, 16), 0) == Reassembler::Outcome::NO_SESSION,
          "ttl: late chunk has no session");
}

static void test_reassembler_session_cap() {
    Limits limits;
    limits.max_sessions = 2;
    Reassembler r(limits);
    Harness h;
    h.chunk_size = 16;
    h.buffer.assign(64, '\0');

    const std::string payload(44, 'b');
    for (int i = 0; i < 3; i++) {
        Manifest m = session_manifest(payload, 16);
        m.id = std::string(16, (char)('a' + i));
        check(r.begin(m, h.sink()) == Reassembler::Outcome::ACCEPTED, "cap: session accepted");
    }
    check_u32(r.session_count(), 2, "cap: oldest session evicted");
}

int main() {
    test_encoder_golden();
    test_chunk_size_budget();
    test_decoder_golden();
    test_decoder_tolerance();
    test_reassembler_out_of_order();
    test_reassembler_rejections();
    test_reassembler_resume_and_ttl();
    test_reassembler_session_cap();

    if (failures) {
        std::printf("\n%d FAILURES\n", failures);
        return 1;
    }
    std::printf("\nall LMAF core checks passed\n");
    return 0;
}
