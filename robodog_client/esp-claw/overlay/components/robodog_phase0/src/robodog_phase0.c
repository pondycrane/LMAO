/*
 * RoboDog Phase 0 overlay for the ESP-Claw edge_agent (LMAO-owned).
 *
 * DESIGN.md Phase 0 (spike):
 *   - RD_SHOT capture publishing (pixel-for-pixel frame proof compatible with
 *     the host robodog_client/capture.py — same 15000 B 400x300 contract as
 *     the hermes/calendar firmwares' capture hooks).
 *   - Device-initiated HTTP round-trips to the user's model endpoints:
 *         rd_asr   device -> Whisper   (/v1/audio/transcriptions, multipart)
 *         rd_tts   device -> Kokoro    (/v1/audio/speech, JSON -> WAV)
 *         rd_chat  device -> LLM agent (native claw_agent_mgr per-turn seam —
 *                    the exact chat-injection API webim uses; Phase 2 wires
 *                    ASR text into it for the full voice loop).
 *
 * SPDX-License-Identifier: Apache-2.0
 */
#include "robodog_phase0.h"
#include "robodog_ui.h"
#include "robodog_http.h"
#include "robodog_voice.h"

#include <stdio.h>
#include <string.h>
#include <stdlib.h>
#include <stdint.h>

#include "esp_log.h"
#include "esp_err.h"
#include "esp_console.h"
#include "esp_timer.h"
#include "esp_heap_caps.h"
#include "freertos/FreeRTOS.h"
#include "freertos/task.h"

#include "claw_agent_mgr.h"
#include "claw_core.h"

/* Embedded corpus utterance ("what can you do", 16 kHz WAV), generated by
 * build_esp_claw.sh from robodog_client/voice/corpus/capabilities.wav so the
 * single corpus copy of record stays authoritative (DRY). Provides a real
 * request payload for the device->Whisper round-trip probe. */
#include "robodog_asr_sample.inc"

static const char *TAG = "robodog";

/* ── RD_SHOT capture publishing ──────────────────────────────────────────── */

#define RD_SHOT_MAX_BUF       (16384)
#define RD_SHOT_INTERVAL_US   (4000000ULL) /* 15000 B -> ~30 KB hex @115200 ~= 2.6 s */

static portMUX_TYPE s_rdshot_mux = portMUX_INITIALIZER_UNLOCKED;
static uint8_t *s_rdshot_frame;     /* retained copy of the last flushed frame */
static uint8_t *s_rdshot_dump;      /* private copy the publisher prints from */
static size_t s_rdshot_len;
static int s_rdshot_w, s_rdshot_h;
static volatile bool s_rdshot_force;
static volatile uint64_t s_rdshot_last_pub_us;
static TaskHandle_t s_rdshot_task;

void robodog_rdshot_capture_now(void);
/* Declared in the overlay boards/waveshare.../setup_device.c: the custom
 * panel's live 1-bpp frame memory (deterministic RD_SHOT fallback). */
uint8_t *robodog_board_display_frame(size_t *out_len, int *out_w, int *out_h);

static void rd_shot_dump(const uint8_t *buf, size_t len, int w, int h)
{
    char line[65];
    unsigned o = 0;
    printf("\nRD_SHOT_BEGIN bufsize=%d w=%d h=%d\n", (int)len, w, h);
    /* 32 hex bytes per line, matching the hermes/calendar frame format that
     * capture.py HEX_RE[^0-9a-fA-F]+ / fromhex() round-trips. */
    for (o = 0; o < len; o++) {
        unsigned i = o & 0x1f;
        line[i * 2] = "0123456789abcdef"[buf[o] >> 4];
        line[i * 2 + 1] = "0123456789abcdef"[buf[o] & 0xf];
        if (i == 0x1f) {
            line[64] = '\0';
            printf("%s\n", line);
        }
    }
    if (o & 0x1f) {
        printf("%.*s\n", (int)((o & 0x1f) * 2), line);
    }
    printf("RD_SHOT_END\n");
    fflush(stdout);
}

static void rd_shot_task(void *arg)
{
    (void)arg;
    for (;;) {
        /* Wake on a flush notification OR the 4 s capture interval, so a
         * static LVGL screen (no dirty-region flushes after the first
         * paint) keeps yielding a continuous RD_SHOT stream instead of
         * stalling until the next repaint. */
        ulTaskNotifyTake(pdTRUE, pdMS_TO_TICKS(RD_SHOT_INTERVAL_US / 1000));
        const uint64_t now = esp_timer_get_time();
        const bool due = s_rdshot_force ||
                         (now - s_rdshot_last_pub_us >= RD_SHOT_INTERVAL_US);
        if (!due) {
            continue;
        }
        const uint8_t *frame = s_rdshot_frame;
        size_t len = s_rdshot_len;
        if (frame == NULL || len == 0) {
            /* Deterministic fallback: the panel's live 1-bpp frame memory is
             * always valid (blank white on a fresh boot, current content after
             * any render), so a capture never has "no frame" even before the
             * first flush arrives. */
            size_t plen = 0;
            int pw = 0, ph = 0;
            uint8_t *pf = robodog_board_display_frame(&plen, &pw, &ph);
            if (pf == NULL || plen == 0) {
                s_rdshot_force = false;
                ESP_LOGW(TAG, "rdshot: no panel frame captured yet");
                continue;
            }
            frame = pf;
            len = plen < RD_SHOT_MAX_BUF ? plen : RD_SHOT_MAX_BUF;
        }
        memcpy(s_rdshot_dump, frame, len);
        rd_shot_dump(s_rdshot_dump, len, s_rdshot_w != 0 ? s_rdshot_w : 400,
                     s_rdshot_h != 0 ? s_rdshot_h : 300);
        s_rdshot_last_pub_us = esp_timer_get_time();
        s_rdshot_force = false;
    }
}

void robodog_rdshot_publish(const uint8_t *buf, size_t len, int w, int h)
{
    if (buf == NULL || len == 0 || s_rdshot_frame == NULL || s_rdshot_dump == NULL) {
        return;
    }
    if (len > RD_SHOT_MAX_BUF) {
        len = RD_SHOT_MAX_BUF;
    }
    /* Always retain the latest flushed frame (a flush is low-frequency: text /
     * boot renders only), so a force-publish right after a UI render reads the
     * NEW frame, never a stale one held inside the 4 s self-tick window. */
    portENTER_CRITICAL(&s_rdshot_mux);
    memcpy(s_rdshot_frame, buf, len);
    s_rdshot_len = len;
    s_rdshot_w = w;
    s_rdshot_h = h;
    portEXIT_CRITICAL(&s_rdshot_mux);
    /* Wake the publisher when forced or when the capture interval elapsed. */
    const uint64_t now = esp_timer_get_time();
    if (s_rdshot_force || (now - s_rdshot_last_pub_us >= RD_SHOT_INTERVAL_US)) {
        xTaskNotifyGive(s_rdshot_task);
    }
}

static int cmd_rdshot(int argc, char **argv)
{
    (void)argc;
    (void)argv;
    robodog_rdshot_capture_now();
    return 0;
}

/* Immediate publish (bypasses the 4 s self-tick): used by the UI after a
 * forced LVGL refresh so RD_SHOT right now reflects the freshly rendered
 * frame instead of the retained one. */
void robodog_rdshot_capture_now(void)
{
    s_rdshot_force = true;
    if (s_rdshot_task != NULL) {
        xTaskNotifyGive(s_rdshot_task);
    } else {
        ESP_LOGW(TAG, "rdshot: not initialised yet");
    }
}

/* ── rd_asr: device -> Whisper multipart round-trip ─────────────────────── */

static int cmd_rd_asr(int argc, char **argv)
{
    (void)argc;
    (void)argv;
    /* Reuse the voice loop's Whisper client on the embedded corpus WAV — a
     * single copy of the multipart/ASR path (DRY).  The .inc holds a full
     * RIFF/WAVE file (16 kHz s16 mono), so strip the WAV header and hand the
     * PCM to robodog_voice_asr, which rebuilds its own canonical WAV body. */
    uint32_t src_rate = 0;
    const size_t off = robodog_wav_pcm_offset(
        (const uint8_t *)robodog_asr_sample_wav,
        sizeof(robodog_asr_sample_wav), &src_rate);
    if (off == 0 || off >= sizeof(robodog_asr_sample_wav)) {
        ESP_LOGE(TAG, "rd_asr: embedded corpus is not a RIFF/WAVE blob");
        return 1;
    }
    const size_t samples =
        (sizeof(robodog_asr_sample_wav) - off) / sizeof(int16_t);
    const int16_t *pcm = (const int16_t *)(robodog_asr_sample_wav + off);
    ESP_LOGI(TAG, "rd_asr: POST %s (%u samples @%lu Hz) ...",
             CONFIG_ROBODOG_ASR_URL, (unsigned)samples,
             (unsigned long)src_rate);
    char *text = robodog_voice_asr(pcm, samples);
    if (text == NULL) {
        ESP_LOGE(TAG, "rd_asr: Whisper round-trip failed");
        return 1;
    }
    /* robodog_voice_asr already logged `ASR text=...` (the E2E hook); keep the
     * probe's own one-line summary too. */
    ESP_LOGI(TAG, "rd_asr: round-trip ok: text=\"%.160s\"", text);
    free(text);
    return 0;
}

/* ── rd_tts: device -> Kokoro TTS round-trip ────────────────────────────── */

static int cmd_rd_tts(int argc, char **argv)
{
    (void)argc;
    (void)argv;
    /* Reuse the voice loop's Kokoro client (single copy of the request body +
     * buffering — DRY) and report the blob WITHOUT playing it, so the probe
     * isolates the endpoint round-trip from the speaker path. */
    robodog_http_rx_t rx;
    robodog_http_rx_init(&rx, CONFIG_ROBODOG_VOICE_TTS_MAX_RESPONSE);
    if (rx.buf == NULL) {
        ESP_LOGE(TAG, "rd_tts: no memory for response buffer");
        return 1;
    }
    const esp_err_t err = robodog_voice_tts_fetch(
        "RoboDog claw phase zero TTS round trip.", &rx);
    if (err != ESP_OK) {
        ESP_LOGE(TAG, "rd_tts: Kokoro round-trip failed: %s",
                 esp_err_to_name(err));
        robodog_http_rx_free(&rx);
        return 1;
    }
    const bool riff = rx.len >= 4 && rx.buf[0] == 'R' && rx.buf[1] == 'I' &&
                      rx.buf[2] == 'F' && rx.buf[3] == 'F';
    ESP_LOGI(TAG, "rd_tts: POST %s -> got %u WAV bytes (starts RIFF: %s)",
             CONFIG_ROBODOG_TTS_URL, (unsigned)rx.len, riff ? "yes" : "no");
    robodog_http_rx_free(&rx);
    return 0;
}

/* ── rd_chat: device -> agent -> LLM via the native chat-injection seam ─── */

static int cmd_rd_chat(int argc, char **argv)
{
    if (argc < 2 || argv[1][0] == '\0') {
        ESP_LOGE(TAG, "rd_chat: usage: rd_chat <user text...>");
        return 1;
    }
    char text[1024];
    text[0] = '\0';
    for (int i = 1; i < argc; i++) {
        if (i > 1) {
            strlcat(text, " ", sizeof(text));
        }
        strlcat(text, argv[i], sizeof(text));
    }

    /* The exact native seam the webim HTTP handler uses (and Phase 2 will
     * feed ASR text through): a per-turn independent agent run against the
     * NVS-configured LLM endpoint, blocking for the reply.  flags=0 keeps the
     * response queue so receive_root_for() can collect the reply. */
    /* Render the user transcript first (same role/timing as a user message
     * finalizing), then mark the agent as reasoning while the run is in
     * flight; the reply is appended when it finalizes.  Same state vocabulary
     * as the voice loop ("processing" — the UI states are idle / listening /
     * processing / responding / error / truncated). */
    robodog_ui_show_user(text);
    robodog_ui_set_agent_state("processing");

    uint32_t request_id = 0;
    esp_err_t err = claw_agent_mgr_start_root_run_text(
        text, NULL, 0, CONFIG_ROBODOG_LLM_TIMEOUT_MS, &request_id);
    if (err != ESP_OK) {
        ESP_LOGE(TAG, "rd_chat: start_root_run_text failed: %s (agent/LLM not ready?)",
                 esp_err_to_name(err));
        robodog_ui_set_agent_state("error");
        return 1;
    }
    claw_core_response_t resp;
    memset(&resp, 0, sizeof(resp));
    err = claw_agent_mgr_receive_root_for(request_id, &resp,
                                          CONFIG_ROBODOG_LLM_TIMEOUT_MS + 30000);
    if (err == ESP_OK && resp.text != NULL) {
        /* Line-safe reply log: a raw "%s" would truncate at the first newline
         * of the agent's multi-line markdown reply; JSON-escape like the voice
         * turn so the console carries the FULL reply on one line. */
        char *reply_esc = robodog_json_escape(resp.text);
        ESP_LOGI(TAG, "rd_chat reply: %s",
                 reply_esc != NULL ? reply_esc : resp.text);
        free(reply_esc);
        robodog_ui_show_assistant(resp.text);
        /* Text-only probe (no playback): the assistant render no longer sets
         * the terminal state itself, so mark the turn done here. */
        robodog_ui_set_agent_state("idle");
    } else if (resp.error_message != NULL) {
        ESP_LOGE(TAG, "rd_chat: agent error (%s): %s", esp_err_to_name(err),
                 resp.error_message);
        robodog_ui_set_agent_state("error");
        return 1;
    } else {
        ESP_LOGE(TAG, "rd_chat: receive_root_for failed: %s", esp_err_to_name(err));
        robodog_ui_set_agent_state("error");
        return 1;
    }
    return 0;
}

/* ── registration ────────────────────────────────────────────────────────── */

static void robodog_register_commands(void)
{
    const esp_console_cmd_t cmds[] = {
        {.command = "rdshot",
         .help = "force an RD_SHOT capture frame over the console",
         .func = &cmd_rdshot},
        {.command = "rd_asr",
         .help = "device->Whisper round-trip: POST the embedded corpus WAV",
         .func = &cmd_rd_asr},
        {.command = "rd_tts",
         .help = "device->Kokoro round-trip: POST JSON, receive WAV",
         .func = &cmd_rd_tts},
        {.command = "rd_chat",
         .help = "device->agent->LLM round-trip via the native injection seam",
         .func = &cmd_rd_chat},
    };
    for (size_t i = 0; i < sizeof(cmds) / sizeof(cmds[0]); i++) {
        if (esp_console_cmd_register(&cmds[i]) != ESP_OK) {
            ESP_LOGW(TAG, "failed to register console command '%s'", cmds[i].command);
        }
    }
}

esp_err_t robodog_init(void)
{
    s_rdshot_frame = heap_caps_malloc(RD_SHOT_MAX_BUF, MALLOC_CAP_SPIRAM | MALLOC_CAP_8BIT);
    s_rdshot_dump = heap_caps_malloc(RD_SHOT_MAX_BUF, MALLOC_CAP_SPIRAM | MALLOC_CAP_8BIT);
    if (s_rdshot_frame == NULL || s_rdshot_dump == NULL) {
        ESP_LOGW(TAG, "RD_SHOT capture unavailable (no SPIRAM); probes still work");
        if (s_rdshot_frame != NULL) {
            heap_caps_free(s_rdshot_frame);
            s_rdshot_frame = NULL;
        }
        if (s_rdshot_dump != NULL) {
            heap_caps_free(s_rdshot_dump);
            s_rdshot_dump = NULL;
        }
    } else if (xTaskCreate(rd_shot_task, "rdshot", 4096, NULL, 3, &s_rdshot_task) != pdPASS) {
        ESP_LOGW(TAG, "RD_SHOT publisher task create failed");
    }

    robodog_register_commands();
    /* Phase 1: bring up the deterministic text-only UI (panel + LVGL). */
    (void)robodog_ui_start();
    /* Phase 2: the device-initiated voice loop (rd_listen trigger). */
    (void)robodog_voice_init();
    ESP_LOGI(TAG, "RoboDog Phase 1 overlay ready: rdshot / rd_asr / rd_tts / rd_chat + text UI");
    return ESP_OK;
}
